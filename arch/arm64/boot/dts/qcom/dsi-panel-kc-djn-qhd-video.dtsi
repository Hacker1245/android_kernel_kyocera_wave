/*
 * This software is contributed or developed by KYOCERA Corporation.
 * (C) 2015 KYOCERA Corporation
 */
/* Copyright (c) 2013-2014, The Linux Foundation. All rights reserved.
 *
 * This program is free software; you can redistribute it and/or modify
 * it under the terms of the GNU General Public License version 2 and
 * only version 2 as published by the Free Software Foundation.
 *
 * This program is distributed in the hope that it will be useful,
 * but WITHOUT ANY WARRANTY; without even the implied warranty of
 * MERCHANTABILITY or FITNESS FOR A PARTICULAR PURPOSE.  See the
 * GNU General Public License for more details.
 */

/*---------------------------------------------------------------------------
 * This file is autogenerated file using gcdb parser. Please do not edit it.
 * Update input XML file to add a new entry or update variable in this file
 * VERSION = "1.0"
 *---------------------------------------------------------------------------*/
&mdss_mdp {
	dsi_kc_djn_qhd_vid: qcom,mdss_dsi_kc_djn_qhd_video {
		qcom,mdss-dsi-panel-name = "kc djn qhd video mode dsi panel";
		qcom,mdss-dsi-panel-controller = <&mdss_dsi0>;
		qcom,mdss-dsi-panel-type = "dsi_video_mode";
		qcom,mdss-dsi-panel-destination = "display_1";
		qcom,mdss-dsi-panel-framerate = <60>;
		qcom,mdss-dsi-virtual-channel-id = <0>;
		qcom,mdss-dsi-stream = <0>;
		qcom,mdss-dsi-panel-width = <540>;
		qcom,mdss-dsi-panel-height = <960>;
		qcom,mdss-dsi-h-front-porch = <12>;
		qcom,mdss-dsi-h-back-porch = <16>;
		qcom,mdss-dsi-h-pulse-width = <6>;
		qcom,mdss-dsi-h-sync-skew = <0>;
		qcom,mdss-dsi-v-back-porch = <10>;
		qcom,mdss-dsi-v-front-porch = <14>;
		qcom,mdss-dsi-v-pulse-width = <4>;
		qcom,mdss-dsi-h-left-border = <0>;
		qcom,mdss-dsi-h-right-border = <0>;
		qcom,mdss-dsi-v-top-border = <0>;
		qcom,mdss-dsi-v-bottom-border = <0>;
		qcom,mdss-dsi-bpp = <24>;
		qcom,mdss-dsi-underflow-color = <0xff>;
		qcom,mdss-dsi-border-color = <0>;
		qcom,mdss-dsi-on-command = [
			05 01 00 00 05 00 01 01
			15 01 00 00 00 00 02 00 00
			39 01 00 00 00 00 04 FF 96 05 01
			15 01 00 00 00 00 02 00 80
			39 01 00 00 00 00 03 FF 96 05
			15 01 00 00 00 00 02 00 00
			15 01 00 00 00 00 02 D7 00
			15 01 00 00 00 00 02 00 92
			39 01 00 00 00 00 03 FF 10 02
			15 01 00 00 00 00 02 00 00
			15 01 00 00 00 00 02 A0 00
			15 01 00 00 00 00 02 00 C5
			15 01 00 00 00 00 02 B0 03
			15 01 00 00 00 00 02 00 83
			15 01 00 00 00 00 02 B2 80
			15 01 00 00 00 00 02 00 89
			15 01 00 00 00 00 02 C0 01
			15 01 00 00 00 00 02 00 B4
			15 01 00 00 00 00 02 C0 50
			15 01 00 00 00 00 02 00 B5
			15 01 00 00 00 00 02 C0 18
			15 01 00 00 00 00 02 00 80
			39 01 00 00 00 00 03 C1 36 66
			15 01 00 00 00 00 02 00 A0
			15 01 00 00 00 00 02 C1 00
			15 01 00 00 00 00 02 00 80
			15 01 00 00 00 00 02 C4 9C
			15 01 00 00 00 00 02 00 80
			39 01 00 00 00 00 05 C5 08 00 A0 11
			15 01 00 00 00 00 02 00 90
			39 01 00 00 00 00 08 C5 96 76 01 03 55 55 34
			15 01 00 00 00 00 02 00 B0
			39 01 00 00 00 00 03 C5 04 28
			15 01 00 00 00 00 02 00 C0
			15 01 00 00 00 00 02 C0 00
			15 01 00 00 00 00 02 00 B2
			39 01 00 00 00 00 05 F5 15 00 15 00
			15 01 00 00 00 00 02 00 80
			39 01 00 00 00 00 0B CB 00 00 00 00 00 00 00 00 00 00
			15 01 00 00 00 00 02 00 90
			39 01 00 00 00 00 10 CB 00 00 00 00 00 00 00 00 00 00 00 00 00 00 00
			15 01 00 00 00 00 02 00 A0
			39 01 00 00 00 00 10 CB 00 00 00 00 00 00 00 00 00 00 00 00 00 00 00
			15 01 00 00 00 00 02 00 B0
			39 01 00 00 00 00 0B CB 00 00 00 00 00 00 00 00 00 00
			15 01 00 00 00 00 02 00 C0
			39 01 00 00 00 00 10 CB 04 04 04 04 00 04 00 04 00 04 00 04 04 04 00
			15 01 00 00 00 00 02 00 D0
			39 01 00 00 00 00 10 CB 00 00 00 00 00 04 04 04 04 00 04 00 04 00 04
			15 01 00 00 00 00 02 00 E0
			39 01 00 00 00 00 0B CB 00 04 04 04 00 00 00 00 00 00
			15 01 00 00 00 00 02 00 F0
			39 01 00 00 00 00 0B CB 00 CC CC 00 00 00 CC CC 0F 00
			15 01 00 00 00 00 02 00 80
			39 01 00 00 00 00 0B CC 26 25 21 22 00 0C 00 0A 00 10
			15 01 00 00 00 00 02 00 90
			39 01 00 00 00 00 10 CC 00 0E 02 04 00 00 00 00 00 00 26 25 21 22 00
			15 01 00 00 00 00 02 00 A0
			39 01 00 00 00 00 10 CC 0B 00 09 00 0F 00 0D 01 03 00 00 00 00 00 00
			15 01 00 00 00 00 02 00 B0
			39 01 00 00 00 00 0B CC 25 26 21 22 00 0D 00 0F 00 09
			15 01 00 00 00 00 02 00 C0
			39 01 00 00 00 00 10 CC 00 0B 03 01 00 00 00 00 00 00 25 26 21 22 00
			15 01 00 00 00 00 02 00 D0
			39 01 00 00 00 00 10 CC 0E 00 10 00 0A 00 0C 04 02 00 00 00 00 00 00
			15 01 00 00 00 00 02 00 80
			39 01 00 00 00 00 0D CE 8B 03 28 8A 03 28 89 03 28 88 03 28
			15 01 00 00 00 00 02 00 90
			39 01 00 00 00 00 0F CE F0 00 00 F0 00 00 F0 00 00 F0 00 00 00 00
			15 01 00 00 00 00 02 00 A0
			39 01 00 00 00 00 0F CE 38 07 03 C0 00 18 00 38 06 03 C1 00 18 00
			15 01 00 00 00 00 02 00 B0
			39 01 00 00 00 00 0F CE 38 05 03 C2 00 18 00 38 04 03 C3 00 18 00
			15 01 00 00 00 00 02 00 C0
			39 01 00 00 00 00 0F CE 38 03 03 C4 00 18 00 38 02 03 C5 00 18 00
			15 01 00 00 00 00 02 00 D0
			39 01 00 00 00 00 0F CE 38 01 03 C6 00 18 00 38 00 03 C7 00 18 00
			15 01 00 00 00 00 02 00 C0
			15 01 00 00 00 00 02 CF 02
			15 01 00 00 00 00 02 00 C7
			15 01 00 00 00 00 02 CF 00
			15 01 00 00 00 00 02 00 00
			39 01 00 00 00 00 03 D8 6F 6F
			];
		qcom,mdss-dsi-no-otp-command = [
			15 01 00 00 00 00 02 00 00
			15 01 00 00 00 00 02 D9 4C
			];
		qcom,mdss-dsi-on2-command = [
			15 01 00 00 00 00 02 00 00
			39 01 00 00 00 00 11 E1 03 0A 0F 0D 06 0E 0A 09 04 07 0E 08 0F 16 11 0A
			15 01 00 00 00 00 02 00 00
			39 01 00 00 00 00 11 E2 03 0A 0F 0D 06 0E 0A 09 04 07 0E 08 0F 16 11 0A
			15 01 00 00 00 00 02 00 92
			15 01 00 00 00 00 02 CA CC
			15 01 00 00 00 00 02 00 B1
			15 01 00 00 00 00 02 C6 0E
			15 01 00 00 00 00 02 00 00
			15 01 00 00 00 00 02 00 81
			39 01 00 00 00 00 10 CA CC D0 D4 D8 DC E0 E4 E7 EA ED F0 F3 F6 F9 FC
			15 01 00 00 00 00 02 00 00
			15 01 00 00 00 00 02 C7 10
			39 01 00 00 00 00 13 C8 80 88 88 88 88 88 88 88 88 88 88 88 88 88 88 88 88 88
			15 01 00 00 00 00 02 00 00
			15 01 00 00 00 00 02 C7 11
			39 01 00 00 00 00 13 C8 80 99 99 89 88 88 88 88 88 88 88 88 88 88 88 77 77 87
			15 01 00 00 00 00 02 00 00
			15 01 00 00 00 00 02 C7 12
			39 01 00 00 00 00 13 C8 80 98 99 99 88 88 88 88 88 88 88 88 88 88 78 77 77 88
			15 01 00 00 00 00 02 00 00
			15 01 00 00 00 00 02 C7 13
			39 01 00 00 00 00 13 C8 80 88 99 99 89 88 88 88 88 88 88 88 88 88 77 77 88 88
			15 01 00 00 00 00 02 00 00
			15 01 00 00 00 00 02 C7 14
			39 01 00 00 00 00 13 C8 80 88 98 99 99 88 88 88 88 88 88 88 88 88 77 77 88 88
			15 01 00 00 00 00 02 00 00
			15 01 00 00 00 00 02 C7 15
			39 01 00 00 00 00 13 C8 90 89 88 88 99 99 88 88 98 99 88 88 88 88 78 67 77 67
			15 01 00 00 00 00 02 00 00
			15 01 00 00 00 00 02 C7 16
			39 01 00 00 00 00 13 C8 90 88 88 88 99 99 88 88 98 89 88 88 88 88 88 77 77 67
			15 01 00 00 00 00 02 00 00
			15 01 00 00 00 00 02 C7 17
			39 01 00 00 00 00 13 C8 90 88 88 98 99 88 88 88 98 89 88 88 88 88 88 88 77 66
			15 01 00 00 00 00 02 00 00
			15 01 00 00 00 00 02 C7 18
			39 01 00 00 00 00 13 C8 90 88 88 88 99 89 88 88 98 89 88 89 88 88 88 88 76 66
			15 01 00 00 00 00 02 00 00
			15 01 00 00 00 00 02 C7 19
			39 01 00 00 00 00 13 C8 80 88 88 88 98 99 89 88 88 99 88 88 88 88 88 88 77 66
			15 01 00 00 00 00 02 00 00
			15 01 00 00 00 00 02 C7 1A
			39 01 00 00 00 00 13 C8 80 88 88 88 98 99 88 88 88 99 88 88 88 88 88 78 77 77
			15 01 00 00 00 00 02 00 00
			15 01 00 00 00 00 02 C7 1B
			39 01 00 00 00 00 13 C8 80 88 88 88 98 99 88 88 88 98 88 88 88 88 88 88 77 77
			15 01 00 00 00 00 02 00 00
			15 01 00 00 00 00 02 C7 1C
			39 01 00 00 00 00 13 C8 80 88 88 88 88 99 88 88 88 88 89 88 88 88 88 88 67 88
			15 01 00 00 00 00 02 00 00
			15 01 00 00 00 00 02 C7 1D
			39 01 00 00 00 00 13 C8 80 88 88 88 88 98 88 88 88 88 98 88 88 88 88 88 88 78
			15 01 00 00 00 00 02 00 00
			15 01 00 00 00 00 02 C7 1E
			39 01 00 00 00 00 13 C8 80 88 88 88 88 99 88 88 88 88 88 88 88 88 88 88 88 77
			15 01 00 00 00 00 02 00 00
			15 01 00 00 00 00 02 C7 1F
			39 01 00 00 00 00 13 C8 80 88 88 88 88 88 88 88 88 88 88 88 88 88 88 88 88 88
			15 01 00 00 00 00 02 00 80
			39 01 00 00 00 00 10 CA 8E 95 9D A4 AB B2 BA C1 C8 CF D7 DE E5 EC F4
			15 01 00 00 00 00 02 00 00
			15 01 00 00 00 00 02 C7 00
			15 01 00 00 00 00 02 00 00
			15 01 00 00 00 00 02 51 FF
			15 01 00 00 00 00 02 53 24
			15 01 00 00 00 00 02 55 02
			15 01 00 00 00 00 02 00 80
			15 01 00 00 00 00 02 C6 34
			15 01 00 00 00 00 02 00 00
			39 01 00 00 00 00 04 FF FF FF FF];
		qcom,mdss-dsi-on-post-command = [
			05 01 00 00 78 00 01 11
			05 01 00 00 00 00 01 29];
		qcom,mdss-dsi-off-command = [
			05 01 00 00 14 00 01 28
			05 01 00 00 50 00 01 10];
		qcom,mdss-dsi-on-command-state = "dsi_lp_mode";
		qcom,mdss-dsi-no-otp-command-state = "dsi_lp_mode";
		qcom,mdss-dsi-on2-command-state = "dsi_lp_mode";
		qcom,mdss-dsi-on-post-command-state = "dsi_lp_mode";
		qcom,mdss-dsi-off-command-state = "dsi_hs_mode";
		qcom,mdss-dsi-h-sync-pulse = <0>;
		qcom,mdss-dsi-traffic-mode = "non_burst_sync_event";
		qcom,mdss-dsi-bllp-eof-power-mode;
		qcom,mdss-dsi-bllp-power-mode;
		qcom,mdss-dsi-lane-0-state;
		qcom,mdss-dsi-lane-1-state;
		qcom,mdss-dsi-panel-timings = [7B 22 10 00 3C 42 14 2A 15 03 04 00];
		qcom,mdss-dsi-t-clk-post = <0x04>;
		qcom,mdss-dsi-t-clk-pre = <0x1A>;
		qcom,mdss-dsi-bl-min-level = <1>;
		qcom,mdss-dsi-bl-max-level = <4095>;
		qcom,mdss-dsi-dma-trigger = "trigger_sw";
		qcom,mdss-dsi-mdp-trigger = "none";
		qcom,mdss-dsi-bl-pmic-control-type = "bl_ctrl_wled";
		qcom,mdss-pan-physical-width-dimension = <62>;
		qcom,mdss-pan-physical-height-dimension = <110>;
		qcom,mdss-dsi-lp11-init;
		qcom,mdss-dsi-panel-status-command = [06 01 00 01 05 00 01 0A];
		qcom,mdss-dsi-panel-status-command-state = "dsi_lp_mode";
		qcom,mdss-dsi-panel-status-check-mode = "reg_read";
		qcom,mdss-dsi-panel-status-value = <0x9c>;

		kc,pcc_r = <0x8000>;
		kc,pcc_g = <0x77de>;
		kc,pcc_b = <0x79b3>;
		kc,r_stage_enable = <1 1 1 1 1 1 1 1 1 1 1 1 1 1 1 1>;
		kc,g_stage_enable = <1 1 1 1 1 1 1 1 1 1 1 1 1 1 1 1>;
		kc,b_stage_enable = <1 1 1 1 1 1 1 1 1 1 1 1 1 1 1 1>;
		kc,r_x_start = <
			0x0000 0x0002 0x000e 0x0033 0x008a 0x0138 0x026f 0x046f
			0x0787 0x0c18 0x0fff 0x0fff 0x0fff 0x0fff 0x0fff 0x0fff>;
		kc,r_slope = <
			0x5d0d 0x0f0f 0x0697 0x039e 0x023d 0x017f 0x010e 0x00c7
			0x0098 0x007d 0x0000 0x0000 0x0000 0x0000 0x0000 0x0000>;
		kc,r_offset = <
			0x0000 0x0475 0x0a23 0x11dc 0x1bcd 0x2810 0x36ad 0x47a8
			0x5b03 0x707b 0x7f80 0x7f80 0x7f80 0x7f80 0x7f80 0x7f80>;
		kc,g_x_start = <
			0x0000 0x0002 0x000e 0x0033 0x008a 0x0138 0x026f 0x046f
			0x0787 0x0c18 0x0fff 0x0fff 0x0fff 0x0fff 0x0fff 0x0fff>;
		kc,g_slope = <
			0x5d0d 0x0f0f 0x0697 0x039e 0x023d 0x017f 0x010e 0x00c7
			0x0098 0x007d 0x0000 0x0000 0x0000 0x0000 0x0000 0x0000>;
		kc,g_offset = <
			0x0000 0x0475 0x0a23 0x11dc 0x1bcd 0x2810 0x36ad 0x47a8
			0x5b03 0x707b 0x7f80 0x7f80 0x7f80 0x7f80 0x7f80 0x7f80>;
		kc,b_x_start = <
			0x0000 0x0002 0x000e 0x0033 0x008a 0x0138 0x026f 0x046f
			0x0787 0x0c18 0x0fff 0x0fff 0x0fff 0x0fff 0x0fff 0x0fff>;
		kc,b_slope = <
			0x5d0d 0x0f0f 0x0697 0x039e 0x023d 0x017f 0x010e 0x00c7
			0x0098 0x007d 0x0000 0x0000 0x0000 0x0000 0x0000 0x0000>;
		kc,b_offset = <
			0x0000 0x0475 0x0a23 0x11dc 0x1bcd 0x2810 0x36ad 0x47a8
			0x5b03 0x707b 0x7f80 0x7f80 0x7f80 0x7f80 0x7f80 0x7f80>;
		kc,igc_c0_c1_data = <
			0x00000000 0x00000000 0x00000000 0x00000000
			0x00000000 0x00010001 0x00010001 0x00020002
			0x00020002 0x00030003 0x00030003 0x00040004
			0x00050005 0x00060006 0x00070007 0x00080008
			0x00090009 0x000b000b 0x000c000c 0x000e000e
			0x000f000f 0x00110011 0x00130013 0x00150015
			0x00170017 0x00190019 0x001b001b 0x001d001d
			0x00200020 0x00220022 0x00250025 0x00280028
			0x002b002b 0x002e002e 0x00310031 0x00340034
			0x00370037 0x003b003b 0x003e003e 0x00420042
			0x00460046 0x00490049 0x004d004d 0x00520052
			0x00560056 0x005a005a 0x005f005f 0x00630063
			0x00680068 0x006d006d 0x00720072 0x00770077
			0x007c007c 0x00810081 0x00870087 0x008c008c
			0x00920092 0x00980098 0x009e009e 0x00a400a4
			0x00aa00aa 0x00b000b0 0x00b600b6 0x00bd00bd
			0x00c400c4 0x00ca00ca 0x00d100d1 0x00d800d8
			0x00e000e0 0x00e700e7 0x00ee00ee 0x00f600f6
			0x00fe00fe 0x01050105 0x010d010d 0x01150115
			0x011e011e 0x01260126 0x012e012e 0x01370137
			0x01400140 0x01480148 0x01510151 0x015b015b
			0x01640164 0x016d016d 0x01770177 0x01800180
			0x018a018a 0x01940194 0x019e019e 0x01a801a8
			0x01b301b3 0x01bd01bd 0x01c801c8 0x01d301d3
			0x01dd01dd 0x01e801e8 0x01f401f4 0x01ff01ff
			0x020a020a 0x02160216 0x02210221 0x022d022d
			0x02390239 0x02450245 0x02520252 0x025e025e
			0x026b026b 0x02770277 0x02840284 0x02910291
			0x029e029e 0x02ab02ab 0x02b902b9 0x02c602c6
			0x02d402d4 0x02e202e2 0x02f002f0 0x02fe02fe
			0x030c030c 0x031a031a 0x03290329 0x03370337
			0x03460346 0x03550355 0x03640364 0x03740374
			0x03830383 0x03920392 0x03a203a2 0x03b203b2
			0x03c203c2 0x03d203d2 0x03e203e2 0x03f303f3
			0x04030403 0x04140414 0x04250425 0x04360436
			0x04470447 0x04580458 0x046a046a 0x047b047b
			0x048d048d 0x049f049f 0x04b104b1 0x04c304c3
			0x04d504d5 0x04e804e8 0x04fa04fa 0x050d050d
			0x05200520 0x05330533 0x05460546 0x055a055a
			0x056d056d 0x05810581 0x05950595 0x05a905a9
			0x05bd05bd 0x05d105d1 0x05e505e5 0x05fa05fa
			0x060f060f 0x06240624 0x06390639 0x064e064e
			0x06630663 0x06790679 0x068e068e 0x06a406a4
			0x06ba06ba 0x06d006d0 0x06e606e6 0x06fd06fd
			0x07130713 0x072a072a 0x07410741 0x07580758
			0x076f076f 0x07860786 0x079e079e 0x07b607b6
			0x07cd07cd 0x07e507e5 0x07fd07fd 0x08160816
			0x082e082e 0x08470847 0x085f085f 0x08780878
			0x08910891 0x08ab08ab 0x08c408c4 0x08de08de
			0x08f708f7 0x09110911 0x092b092b 0x09450945
			0x09600960 0x097a097a 0x09950995 0x09af09af
			0x09ca09ca 0x09e609e6 0x0a010a01 0x0a1c0a1c
			0x0a380a38 0x0a540a54 0x0a6f0a6f 0x0a8c0a8c
			0x0aa80aa8 0x0ac40ac4 0x0ae10ae1 0x0afd0afd
			0x0b1a0b1a 0x0b370b37 0x0b540b54 0x0b720b72
			0x0b8f0b8f 0x0bad0bad 0x0bcb0bcb 0x0be90be9
			0x0c070c07 0x0c250c25 0x0c440c44 0x0c620c62
			0x0c810c81 0x0ca00ca0 0x0cbf0cbf 0x0cdf0cdf
			0x0cfe0cfe 0x0d1e0d1e 0x0d3e0d3e 0x0d5d0d5d
			0x0d7e0d7e 0x0d9e0d9e 0x0dbe0dbe 0x0ddf0ddf
			0x0e000e00 0x0e210e21 0x0e420e42 0x0e630e63
			0x0e840e84 0x0ea60ea6 0x0ec80ec8 0x0eea0eea
			0x0f0c0f0c 0x0f2e0f2e 0x0f500f50 0x0f730f73
			0x0f960f96 0x0fb90fb9 0x0fdc0fdc 0x0fff0fff>;
		kc,igc_c2_data = <
			0x0000 0x0000 0x0000 0x0000
			0x0000 0x0001 0x0001 0x0002
			0x0002 0x0003 0x0003 0x0004
			0x0005 0x0006 0x0007 0x0008
			0x0009 0x000b 0x000c 0x000e
			0x000f 0x0011 0x0013 0x0015
			0x0017 0x0019 0x001b 0x001d
			0x0020 0x0022 0x0025 0x0028
			0x002b 0x002e 0x0031 0x0034
			0x0037 0x003b 0x003e 0x0042
			0x0046 0x0049 0x004d 0x0052
			0x0056 0x005a 0x005f 0x0063
			0x0068 0x006d 0x0072 0x0077
			0x007c 0x0081 0x0087 0x008c
			0x0092 0x0098 0x009e 0x00a4
			0x00aa 0x00b0 0x00b6 0x00bd
			0x00c4 0x00ca 0x00d1 0x00d8
			0x00e0 0x00e7 0x00ee 0x00f6
			0x00fe 0x0105 0x010d 0x0115
			0x011e 0x0126 0x012e 0x0137
			0x0140 0x0148 0x0151 0x015b
			0x0164 0x016d 0x0177 0x0180
			0x018a 0x0194 0x019e 0x01a8
			0x01b3 0x01bd 0x01c8 0x01d3
			0x01dd 0x01e8 0x01f4 0x01ff
			0x020a 0x0216 0x0221 0x022d
			0x0239 0x0245 0x0252 0x025e
			0x026b 0x0277 0x0284 0x0291
			0x029e 0x02ab 0x02b9 0x02c6
			0x02d4 0x02e2 0x02f0 0x02fe
			0x030c 0x031a 0x0329 0x0337
			0x0346 0x0355 0x0364 0x0374
			0x0383 0x0392 0x03a2 0x03b2
			0x03c2 0x03d2 0x03e2 0x03f3
			0x0403 0x0414 0x0425 0x0436
			0x0447 0x0458 0x046a 0x047b
			0x048d 0x049f 0x04b1 0x04c3
			0x04d5 0x04e8 0x04fa 0x050d
			0x0520 0x0533 0x0546 0x055a
			0x056d 0x0581 0x0595 0x05a9
			0x05bd 0x05d1 0x05e5 0x05fa
			0x060f 0x0624 0x0639 0x064e
			0x0663 0x0679 0x068e 0x06a4
			0x06ba 0x06d0 0x06e6 0x06fd
			0x0713 0x072a 0x0741 0x0758
			0x076f 0x0786 0x079e 0x07b6
			0x07cd 0x07e5 0x07fd 0x0816
			0x082e 0x0847 0x085f 0x0878
			0x0891 0x08ab 0x08c4 0x08de
			0x08f7 0x0911 0x092b 0x0945
			0x0960 0x097a 0x0995 0x09af
			0x09ca 0x09e6 0x0a01 0x0a1c
			0x0a38 0x0a54 0x0a6f 0x0a8c
			0x0aa8 0x0ac4 0x0ae1 0x0afd
			0x0b1a 0x0b37 0x0b54 0x0b72
			0x0b8f 0x0bad 0x0bcb 0x0be9
			0x0c07 0x0c25 0x0c44 0x0c62
			0x0c81 0x0ca0 0x0cbf 0x0cdf
			0x0cfe 0x0d1e 0x0d3e 0x0d5d
			0x0d7e 0x0d9e 0x0dbe 0x0ddf
			0x0e00 0x0e21 0x0e42 0x0e63
			0x0e84 0x0ea6 0x0ec8 0x0eea
			0x0f0c 0x0f2e 0x0f50 0x0f73
			0x0f96 0x0fb9 0x0fdc 0x0fff>;
		kc,pa_v2_six_zone_curve_p0 = <
			0x00000000 0x00010000 0x00020000 0x00030000
			0x00040000 0x00050000 0x00060000 0x00070000
			0x00080000 0x00090000 0x000a0000 0x000b0000
			0x000c0000 0x000d0000 0x000e0000 0x000f0000
			0x00100000 0x00110000 0x00120000 0x00130000
			0x00140000 0x00150000 0x00160000 0x00170000
			0x00180000 0x00190000 0x001a0000 0x001b0000
			0x001c0000 0x001d0000 0x001e0000 0x001f0000
			0x00200000 0x00210000 0x00220000 0x00230000
			0x00240000 0x00250000 0x00260000 0x00270000
			0x00280000 0x00290000 0x002a0000 0x002b0000
			0x002c0000 0x002d0000 0x002e0000 0x002f0000
			0x00300000 0x00310000 0x00320000 0x00330000
			0x00340000 0x00350000 0x00360000 0x00370000
			0x00380000 0x00390000 0x003a0000 0x003b0000
			0x003c0000 0x003d0000 0x003e0000 0x003f0000
			0x00400000 0x00410000 0x00420000 0x00430000
			0x00440000 0x00450000 0x00460000 0x00470000
			0x00480000 0x00490000 0x004a0000 0x004b0000
			0x004c0000 0x004d0000 0x004e0000 0x004f0000
			0x00500000 0x00510000 0x00520000 0x00530000
			0x00540000 0x00550000 0x00560000 0x00570000
			0x00580000 0x00590000 0x005a0000 0x005b0000
			0x005c0000 0x005d0000 0x005e0000 0x005f0000
			0x00600000 0x00610000 0x00620000 0x00630000
			0x00640000 0x00650000 0x00660000 0x00670000
			0x00680000 0x00690000 0x006a0000 0x006b0000
			0x006c0000 0x006d0000 0x006e0000 0x006f0000
			0x00700000 0x00710000 0x00720000 0x00730000
			0x00740000 0x00750000 0x00760000 0x00770000
			0x00780000 0x00790000 0x007a0000 0x007b0000
			0x007c0000 0x007d0000 0x007e0000 0x007f0000
			0x00800000 0x00810000 0x00820000 0x00830000
			0x00840000 0x00850000 0x00860000 0x00870000
			0x00880000 0x00890000 0x008a0000 0x008b0000
			0x008c0000 0x008d0000 0x008e0000 0x008f0000
			0x00900000 0x00910000 0x00920000 0x00930000
			0x00940000 0x00950000 0x00960000 0x00970000
			0x00980000 0x00990000 0x009a0000 0x009b0000
			0x009c0000 0x009d0000 0x009e0000 0x009f0000
			0x00a00000 0x00a10000 0x00a20000 0x00a30000
			0x00a40000 0x00a50000 0x00a60000 0x00a70000
			0x00a80000 0x00a90000 0x00aa0000 0x00ab0000
			0x00ac0000 0x00ad0000 0x00ae0000 0x00af0000
			0x00b00000 0x00b10000 0x00b20000 0x00b30000
			0x00b40000 0x00b50000 0x00b60000 0x00b70000
			0x00b80000 0x00b90000 0x00ba0000 0x00bb0000
			0x00bc0000 0x00bd0000 0x00be0000 0x00bf0000
			0x00c00000 0x00c10000 0x00c20000 0x00c30000
			0x00c40000 0x00c50000 0x00c60000 0x00c70000
			0x00c80000 0x00c90000 0x00ca0000 0x00cb0000
			0x00cc0000 0x00cd0000 0x00ce0000 0x00cf0000
			0x00d00000 0x00d10000 0x00d20000 0x00d30000
			0x00d40000 0x00d50000 0x00d60000 0x00d70000
			0x00d80000 0x00d90000 0x00da0000 0x00db0000
			0x00dc0000 0x00dd0000 0x00de0000 0x00df0000
			0x00e00000 0x00e10000 0x00e20000 0x00e30000
			0x00e40000 0x00e50000 0x00e60000 0x00e70000
			0x00e80000 0x00e90000 0x00ea0000 0x00eb0000
			0x00ec0000 0x00ed0000 0x00ee0000 0x00ef0000
			0x00f00000 0x00f10000 0x00f20000 0x00f30000
			0x00f40000 0x00f50000 0x00f60000 0x00f70000
			0x00f80000 0x00f90000 0x00fa0000 0x00fb0000
			0x00fc0000 0x00fd0000 0x00fe0000 0x00ff0000
			0x01000000 0x01010000 0x01020000 0x01030000
			0x01040000 0x01050000 0x01060000 0x01070000
			0x01080000 0x01090000 0x010a0000 0x010b0000
			0x010c0000 0x010d0000 0x010e0000 0x010f0000
			0x01100000 0x01110000 0x01120000 0x01130000
			0x01140000 0x01150000 0x01160000 0x01170000
			0x01180000 0x01190000 0x011a0000 0x011b0000
			0x011c0000 0x011d0000 0x011e0000 0x011f0000
			0x01200000 0x01210000 0x01220000 0x01230000
			0x01240000 0x01250000 0x01260000 0x01270000
			0x01280000 0x01290000 0x012a0000 0x012b0000
			0x012c0000 0x012d0000 0x012e0000 0x012f0000
			0x01300000 0x01310000 0x01320000 0x01330000
			0x01340000 0x01350000 0x01360000 0x01370000
			0x01380000 0x01390000 0x013a0000 0x013b0000
			0x013c0000 0x013d0000 0x013e0000 0x013f0000
			0x01400000 0x01410000 0x01420000 0x01430000
			0x01440000 0x01450000 0x01460000 0x01470000
			0x01480000 0x01490000 0x014a0000 0x014b0000
			0x014c0000 0x014d0000 0x014e0000 0x014f0000
			0x01500000 0x01510000 0x01520000 0x01530000
			0x01540000 0x01550000 0x01560000 0x01570000
			0x01580000 0x01590000 0x015a0000 0x015b0000
			0x015c0000 0x015d0000 0x015e0000 0x015f0000
			0x01600000 0x01610000 0x01620000 0x01630000
			0x01640000 0x01650000 0x01660000 0x01670000
			0x01680000 0x01690000 0x016a0000 0x016b0000
			0x016c0000 0x016d0000 0x016e0000 0x016f0000
			0x01700000 0x01710000 0x01720000 0x01730000
			0x01740000 0x01750000 0x01760000 0x01770000
			0x01780000 0x01790000 0x017a0000 0x017b0000
			0x017c0000 0x017d0000 0x017e0000 0x017f0000>;
		kc,pa_v2_six_zone_curve_p1 = <
			0x10a0000 0x1080000 0x1080000 0x1060000
			0x1040000 0x1020000 0x1000000 0x0fd0000
			0x0fa0000 0x0f60000 0x0f10000 0x0ed0000
			0x0e90000 0x0e30000 0x0dd0000 0x0d70000
			0x0d10000 0x0d60000 0x0d10000 0x0d40000
			0x0d80000 0x0e50000 0x0f60000 0x10e0000
			0x1290000 0x1450000 0x1610000 0x1810000
			0x1a90000 0x1d20000 0x1fa0000 0x2210000
			0x24a0000 0x2730000 0x2a70000 0x2d10000
			0x2fa0000 0x32c0000 0x35a0000 0x3840000
			0x3b60000 0x3e70000 0x4120000 0x43f0000
			0x46c0000 0x49b0000 0x4c80000 0x4ed0000
			0x51c0000 0x5400000 0x5650000 0x5890000
			0x5ae0000 0x5c90000 0x5e10000 0x6010000
			0x6180000 0x62a0000 0x63e0000 0x64a0000
			0x6560000 0x6620000 0x66d0000 0x66d0000
			0x67a0000 0x66d0000 0x66d0000 0x6620000
			0x6560000 0x64a0000 0x63e0000 0x62a0000
			0x6180000 0x6010000 0x5e10000 0x5c90000
			0x5ae0000 0x5890000 0x5650000 0x5400000
			0x51c0000 0x4f20000 0x4cd0000 0x4a40000
			0x4790000 0x4540000 0x4300000 0x4100000
			0x3ed0000 0x3c90000 0x3ac0000 0x38d0000
			0x36d0000 0x3560000 0x33e0000 0x31c0000
			0x3050000 0x2ee0000 0x2dd0000 0x2c70000
			0x2b10000 0x29f0000 0x2920000 0x2870000
			0x2800000 0x2790000 0x2730000 0x2750000
			0x2790000 0x2870000 0x2950000 0x2a80000
			0x2b60000 0x2c90000 0x2dd0000 0x2f00000
			0x3030000 0x3120000 0x31f0000 0x3300000
			0x33c0000 0x3460000 0x3500000 0x3560000
			0x35d0000 0x3630000 0x3690000 0x3690000
			0x3700000 0x3690000 0x3690000 0x3630000
			0x35d0000 0x3560000 0x3500000 0x3460000
			0x33c0000 0x3300000 0x31f0000 0x3120000
			0x3030000 0x2f00000 0x2dd0000 0x2c90000
			0x2b60000 0x2a00000 0x28d0000 0x2770000
			0x2610000 0x24e0000 0x23c0000 0x22d0000
			0x21b0000 0x2090000 0x1fb0000 0x1ec0000
			0x1de0000 0x1d30000 0x1c80000 0x1b80000
			0x1ae0000 0x1a40000 0x19d0000 0x1930000
			0x1890000 0x1820000 0x17d0000 0x17a0000
			0x1780000 0x1760000 0x1750000 0x1780000
			0x17c0000 0x1850000 0x18f0000 0x19a0000
			0x1a30000 0x1af0000 0x1bb0000 0x1c70000
			0x1d20000 0x1db0000 0x1e30000 0x1ed0000
			0x1f50000 0x1fa0000 0x2000000 0x2040000
			0x2080000 0x20c0000 0x2100000 0x2100000
			0x2140000 0x2100000 0x2100000 0x20c0000
			0x2080000 0x2040000 0x2000000 0x1fa0000
			0x1f50000 0x1ed0000 0x1e30000 0x1db0000
			0x1d20000 0x1c70000 0x1bb0000 0x1af0000
			0x1a30000 0x1990000 0x18d0000 0x1820000
			0x1770000 0x1700000 0x16a0000 0x1670000
			0x1640000 0x1600000 0x15f0000 0x15e0000
			0x15f0000 0x1630000 0x1660000 0x1660000
			0x1690000 0x16d0000 0x1750000 0x1790000
			0x17d0000 0x1840000 0x18c0000 0x1930000
			0x19d0000 0x1a70000 0x1b00000 0x1bc0000
			0x1c80000 0x1d70000 0x1e70000 0x1f50000
			0x2040000 0x2130000 0x2210000 0x2300000
			0x23e0000 0x2490000 0x2520000 0x25f0000
			0x2680000 0x26f0000 0x2770000 0x27c0000
			0x2800000 0x2850000 0x2890000 0x28a0000
			0x28f0000 0x28a0000 0x2890000 0x2850000
			0x2800000 0x27c0000 0x2770000 0x26f0000
			0x2680000 0x25f0000 0x2520000 0x2490000
			0x23e0000 0x2300000 0x2210000 0x2130000
			0x2040000 0x1f40000 0x1e60000 0x1d60000
			0x1c60000 0x1b80000 0x1ab0000 0x1a00000
			0x1940000 0x1880000 0x17e0000 0x1740000
			0x16a0000 0x1630000 0x15c0000 0x1510000
			0x14a0000 0x1430000 0x1400000 0x13a0000
			0x1330000 0x12f0000 0x12c0000 0x12b0000
			0x12a0000 0x12a0000 0x12a0000 0x12d0000
			0x1320000 0x13a0000 0x1420000 0x14b0000
			0x1530000 0x15c0000 0x1660000 0x16f0000
			0x1780000 0x1800000 0x1860000 0x18e0000
			0x1940000 0x1990000 0x19e0000 0x1a10000
			0x1a40000 0x1a70000 0x1aa0000 0x1aa0000
			0x1ad0000 0x1aa0000 0x1aa0000 0x1a70000
			0x1a40000 0x1a10000 0x19e0000 0x1990000
			0x1940000 0x18e0000 0x1860000 0x1800000
			0x1780000 0x16f0000 0x1660000 0x15c0000
			0x1530000 0x1480000 0x13f0000 0x1340000
			0x1290000 0x1200000 0x1170000 0x1100000
			0x1080000 0x0ff0000 0x0f80000 0x0f10000
			0x0ea0000 0x0e50000 0x0e00000 0x0d80000
			0x0d40000 0x0cf0000 0x0cc0000 0x0c70000
			0x0c20000 0x0bf0000 0x0bd0000 0x0bb0000
			0x0bb0000 0x0ba0000 0x0ba0000 0x0bb0000
			0x0be0000 0x0c20000 0x0c70000 0x0cd0000
			0x0d10000 0x0d70000 0x0dd0000 0x0e30000
			0x0e90000 0x0ed0000 0x0f10000 0x0f60000
			0x0fa0000 0x0fd0000 0x1000000 0x1020000
			0x1040000 0x1060000 0x1080000 0x1080000>;
	};
};
